## CMakeLists.txt
```
#
# nRF91 Certificate Provisioner
# Standalone tool for writing AWS IoT certificates to modem secure storage
#

cmake_minimum_required(VERSION 3.8.2)

find_package(Zephyr REQUIRED HINTS $ENV{ZEPHYR_BASE})
project(nrf91_cert_provisioner)

target_sources(app PRIVATE
    src/main.c
    src/cert_provision.c
)

zephyr_include_directories(src)

# ============================================================================
# Certificate auto-import: reads PEM files from certificates/ folder and
# generates src/certs_credentials.h at build time
# ============================================================================

set(CERTS_DIR ${CMAKE_CURRENT_SOURCE_DIR}/certificates)
set(CREDS_HEADER ${CMAKE_CURRENT_SOURCE_DIR}/src/certs_credentials.h)

# Check that certificates/ folder exists
if(NOT EXISTS ${CERTS_DIR})
    message(FATAL_ERROR
        "certificates/ folder not found!\n"
        "  Create the folder and place your AWS IoT PEM files inside:\n"
        "    mkdir certificates\n"
        "  Required files:\n"
        "    - CA certificate:     *CA*.pem or *root*.pem\n"
        "    - Device certificate: *certificate*.crt or *certificate*.pem\n"
        "    - Private key:        *private*.key or *private*.pem")
endif()

# Find certificate files by pattern
file(GLOB CA_CERT_FILES "${CERTS_DIR}/*CA*.pem" "${CERTS_DIR}/*root*.pem")
file(GLOB DEVICE_CERT_FILES "${CERTS_DIR}/*certificate*.crt" "${CERTS_DIR}/*certificate*.pem")
file(GLOB PRIVATE_KEY_FILES "${CERTS_DIR}/*private*.key" "${CERTS_DIR}/*private*.pem")

list(LENGTH CA_CERT_FILES CA_COUNT)
list(LENGTH DEVICE_CERT_FILES DEV_COUNT)
list(LENGTH PRIVATE_KEY_FILES KEY_COUNT)

# --- Check: all three certificate types must be present ---
set(_MISSING "")
if(CA_COUNT EQUAL 0)
    string(APPEND _MISSING "  - CA certificate:     missing (*CA*.pem or *root*.pem)\n")
endif()
if(DEV_COUNT EQUAL 0)
    string(APPEND _MISSING "  - Device certificate: missing (*certificate*.crt or *certificate*.pem)\n")
endif()
if(KEY_COUNT EQUAL 0)
    string(APPEND _MISSING "  - Private key:        missing (*private*.key or *private*.pem)\n")
endif()
if(NOT _MISSING STREQUAL "")
    message(FATAL_ERROR
        "Certificate files missing in ${CERTS_DIR}/\n"
        "${_MISSING}"
        "  Download your AWS IoT certificates and place them in the certificates/ folder.")
endif()

# --- Check: warn if multiple files match the same pattern ---
if(CA_COUNT GREATER 1)
    message(WARNING "Multiple CA certificates found (${CA_COUNT}). Using first match only.")
endif()
if(DEV_COUNT GREATER 1)
    message(WARNING "Multiple device certificates found (${DEV_COUNT}). Using first match only.")
endif()
if(KEY_COUNT GREATER 1)
    message(WARNING "Multiple private keys found (${KEY_COUNT}). Using first match only.")
endif()

# Take only the first match from each glob
list(GET CA_CERT_FILES 0 CA_CERT_FILE)
list(GET DEVICE_CERT_FILES 0 DEVICE_CERT_FILE)
list(GET PRIVATE_KEY_FILES 0 PRIVATE_KEY_FILE)

# --- Check: files must not be empty ---
file(READ ${CA_CERT_FILE} _CA_RAW)
file(READ ${DEVICE_CERT_FILE} _DEV_RAW)
file(READ ${PRIVATE_KEY_FILE} _KEY_RAW)

string(LENGTH "${_CA_RAW}" _CA_LEN)
string(LENGTH "${_DEV_RAW}" _DEV_LEN)
string(LENGTH "${_KEY_RAW}" _KEY_LEN)

if(_CA_LEN LESS 50)
    message(FATAL_ERROR "CA certificate file appears empty or too small (${_CA_LEN} bytes): ${CA_CERT_FILE}")
endif()
if(_DEV_LEN LESS 50)
    message(FATAL_ERROR "Device certificate file appears empty or too small (${_DEV_LEN} bytes): ${DEVICE_CERT_FILE}")
endif()
if(_KEY_LEN LESS 50)
    message(FATAL_ERROR "Private key file appears empty or too small (${_KEY_LEN} bytes): ${PRIVATE_KEY_FILE}")
endif()

# --- Check: files must contain valid PEM headers ---
string(FIND "${_CA_RAW}" "-----BEGIN" _CA_HAS_PEM)
string(FIND "${_DEV_RAW}" "-----BEGIN" _DEV_HAS_PEM)
string(FIND "${_KEY_RAW}" "-----BEGIN" _KEY_HAS_PEM)

if(_CA_HAS_PEM LESS 0)
    message(FATAL_ERROR
        "CA certificate file does not contain a valid PEM header (-----BEGIN ...):\n"
        "  ${CA_CERT_FILE}\n"
        "  Make sure it is a PEM-encoded file, not DER binary.")
endif()
if(_DEV_HAS_PEM LESS 0)
    message(FATAL_ERROR
        "Device certificate file does not contain a valid PEM header (-----BEGIN ...):\n"
        "  ${DEVICE_CERT_FILE}\n"
        "  Make sure it is a PEM-encoded file, not DER binary.")
endif()
if(_KEY_HAS_PEM LESS 0)
    message(FATAL_ERROR
        "Private key file does not contain a valid PEM header (-----BEGIN ...):\n"
        "  ${PRIVATE_KEY_FILE}\n"
        "  Make sure it is a PEM-encoded file, not DER binary.")
endif()

# --- Check: private key must actually be a key, not a certificate ---
string(FIND "${_KEY_RAW}" "PRIVATE KEY" _KEY_HAS_KEY)
if(_KEY_HAS_KEY LESS 0)
    message(FATAL_ERROR
        "Private key file does not contain 'PRIVATE KEY' header:\n"
        "  ${PRIVATE_KEY_FILE}\n"
        "  This file might be a certificate instead of a private key.")
endif()

# --- Check: device cert must be a certificate, not a key ---
string(FIND "${_DEV_RAW}" "CERTIFICATE" _DEV_HAS_CERT)
if(_DEV_HAS_CERT LESS 0)
    message(FATAL_ERROR
        "Device certificate file does not contain 'CERTIFICATE' header:\n"
        "  ${DEVICE_CERT_FILE}\n"
        "  This file might be a private key instead of a certificate.")
endif()

# --- Check: CA and device cert must not be identical ---
if("${_CA_RAW}" STREQUAL "${_DEV_RAW}")
    message(FATAL_ERROR
        "CA certificate and device certificate are identical!\n"
        "  CA:     ${CA_CERT_FILE}\n"
        "  Device: ${DEVICE_CERT_FILE}\n"
        "  These must be different files.")
endif()

message(STATUS "")
message(STATUS "Certificate auto-import:")
message(STATUS "  CA cert:     ${CA_CERT_FILE}")
message(STATUS "  Device cert: ${DEVICE_CERT_FILE}")
message(STATUS "  Private key: ${PRIVATE_KEY_FILE}")
message(STATUS "  All checks passed")

# ============================================================================
# Convert PEM files to C string literals
# ============================================================================

foreach(CERT_NAME CA_CERT DEVICE_CERT PRIVATE_KEY)
    file(READ ${${CERT_NAME}_FILE} _PEM)
    # Remove carriage returns, split into lines
    string(REPLACE "\r" "" _PEM "${_PEM}")
    string(REPLACE "\n" ";" _LINES "${_PEM}")
    # Build C string array from non-empty lines
    set(_C "")
    foreach(_LINE IN LISTS _LINES)
        if(NOT "${_LINE}" STREQUAL "")
            string(APPEND _C "\t\"${_LINE}\\n\"\n")
        endif()
    endforeach()
    # Remove trailing newline from result
    string(REGEX REPLACE "\n$" "" ${CERT_NAME}_C "${_C}")
endforeach()

# Write the generated header
file(WRITE ${CREDS_HEADER}
"/*
 * AUTO-GENERATED by CMakeLists.txt from certificates/ folder
 * DO NOT edit manually - DO NOT commit to version control!
 */

#ifndef CERTS_CREDENTIALS_H_
#define CERTS_CREDENTIALS_H_

/* Amazon Root CA */
static const char ca_cert[] =
${CA_CERT_C};

/* Device certificate */
static const char device_cert[] =
${DEVICE_CERT_C};

/* Private key */
static const char private_key[] =
${PRIVATE_KEY_C};

#endif /* CERTS_CREDENTIALS_H_ */
")

message(STATUS "  Generated: ${CREDS_HEADER}")
message(STATUS "")
```

## Kconfig
```
#
# nRF91 Certificate Provisioner
#

menu "Certificate Provisioner Settings"

config MQTT_HELPER_SEC_TAG
	int "Security tag for AWS IoT certificates"
	default 16
	help
	  The security tag used to store CA cert, device cert,
	  and private key in the modem secure storage.

endmenu

menu "Zephyr Kernel"
source "Kconfig.zephyr"
endmenu
```

## prj.conf
```kconfig
#
# nRF91 Certificate Provisioner
# Minimal config: modem + certificate provisioning only
#

# General
CONFIG_NCS_SAMPLES_DEFAULTS=y
CONFIG_REBOOT=y

# NEWLIB C
CONFIG_NEWLIB_LIBC=y

# Modem library
CONFIG_NRF_MODEM_LIB=y

# Modem key management (for writing certificates)
CONFIG_MODEM_KEY_MGMT=y

# Modem information (for firmware version)
CONFIG_MODEM_INFO=y

# Security tag for AWS IoT certificates
CONFIG_MQTT_HELPER_SEC_TAG=16

# Heap and stacks
CONFIG_HEAP_MEM_POOL_SIZE=4096
CONFIG_MAIN_STACK_SIZE=4096
```

## src/main.c
```c
/*
 * nRF91 Certificate Provisioner
 * Writes AWS IoT certificates to modem secure storage and prints modem info.
 * Flash this once per device, then switch to the main application.
 */

#include <zephyr/kernel.h>
#include <modem/nrf_modem_lib.h>
#include <modem/modem_info.h>
#include <nrf_modem_at.h>

#include "cert_provision.h"

static void print_modem_info(void)
{
	int err;
	char buf[128];

	printk("\n");
	printk("========================================\n");
	printk("  nRF91 Certificate Provisioner\n");
	printk("========================================\n\n");

	/* Modem firmware version */
	err = modem_info_init();
	if (err) {
		printk("Modem info init failed: %d\n", err);
	} else {
		err = modem_info_string_get(MODEM_INFO_FW_VERSION, buf,
					    sizeof(buf));
		if (err > 0) {
			printk("Modem firmware: %s\n", buf);
		} else {
			printk("Modem firmware: could not read (%d)\n", err);
		}
	}

	/* Hardware version via AT command */
	err = nrf_modem_at_cmd(buf, sizeof(buf), "AT%%HWVERSION");
	if (err == 0) {
		/* Remove trailing \r\n and OK */
		char *end = strstr(buf, "\r");
		if (end) {
			*end = '\0';
		}
		/* Skip "%HWVERSION: " prefix if present */
		char *hw = strstr(buf, ": ");
		printk("Hardware:       %s\n", hw ? hw + 2 : buf);
	}

	/* IMEI */
	err = modem_info_string_get(MODEM_INFO_IMEI, buf, sizeof(buf));
	if (err > 0) {
		printk("IMEI:           %s\n", buf);
	}

	printk("\n");
}

int main(void)
{
	int err;

	printk("Starting nRF91 Certificate Provisioner...\n");

	/* Initialize modem library */
	err = nrf_modem_lib_init();
	if (err) {
		printk("Modem library init failed: %d\n", err);
		return 0;
	}

	/* Print modem information */
	print_modem_info();

	/* Provision certificates */
	err = cert_provision();
	if (err) {
		printk("\nProvisioning FAILED (error %d)\n", err);
		printk("Check that certificate files are correct.\n");
	} else {
		printk("\nAll certificates provisioned successfully!\n");
		printk("You can now flash the main gateway application.\n");
	}

	printk("\n========================================\n");
	printk("  Done. Device is ready.\n");
	printk("========================================\n");

	return 0;
}
```

## src/cert_provision.c
```c
/*
 * Certificate Provisioning Module
 * Writes AWS IoT certificates to modem secure storage at boot
 */

#include <zephyr/kernel.h>
#include <modem/modem_key_mgmt.h>
#include <nrf_modem_at.h>

#include "cert_provision.h"
#include "certs_credentials.h"

/* Security tag matching CONFIG_MQTT_HELPER_SEC_TAG in prj.conf */
#define SEC_TAG CONFIG_MQTT_HELPER_SEC_TAG

static int provision_credential(enum modem_key_mgmt_cred_type type,
				const char *name, const void *data, size_t len)
{
	int err;
	bool exists;

	err = modem_key_mgmt_exists(SEC_TAG, type, &exists);
	if (err) {
		printk("  %s: Failed to check (%d)\n", name, err);
		return err;
	}

	if (exists) {
		/* Compare with stored credential */
		err = modem_key_mgmt_cmp(SEC_TAG, type, data, len);
		if (err == 0) {
			printk("  %s: Already provisioned (match)\n", name);
			return 0;
		}
		/* Mismatch - delete and re-write */
		printk("  %s: Mismatch, updating...\n", name);
		modem_key_mgmt_delete(SEC_TAG, type);
	}

	err = modem_key_mgmt_write(SEC_TAG, type, data, len);
	if (err) {
		printk("  %s: Failed to write (%d)\n", name, err);
		return err;
	}

	printk("  %s: Provisioned OK\n", name);
	return 0;
}

int cert_provision(void)
{
	int err;
	char response[64];

	printk("── Certificate Provisioning (sec_tag %d) ──\n", SEC_TAG);

	/* Ensure modem is in offline mode before writing credentials */
	err = nrf_modem_at_cmd(response, sizeof(response), "AT+CFUN=4");
	if (err) {
		printk("  Warning: Could not set offline mode (%d)\n", err);
	}

	/* Provision CA certificate */
	err = provision_credential(MODEM_KEY_MGMT_CRED_TYPE_CA_CHAIN,
				   "CA cert", ca_cert, sizeof(ca_cert) - 1);
	if (err) {
		return err;
	}

	/* Provision device certificate */
	err = provision_credential(MODEM_KEY_MGMT_CRED_TYPE_PUBLIC_CERT,
				   "Device cert", device_cert,
				   sizeof(device_cert) - 1);
	if (err) {
		return err;
	}

	/* Provision private key */
	err = provision_credential(MODEM_KEY_MGMT_CRED_TYPE_PRIVATE_CERT,
				   "Private key", private_key,
				   sizeof(private_key) - 1);
	if (err) {
		return err;
	}

	printk("  Provisioning complete\n");
	return 0;
}
```

## src/cert_provision.h
```c
/*
 * Certificate Provisioning Module
 * Writes AWS IoT certificates to modem secure storage
 */

#ifndef CERT_PROVISION_H_
#define CERT_PROVISION_H_

/**
 * @brief Provision AWS IoT certificates to modem
 *
 * Checks if certificates already exist in modem storage.
 * If not, writes CA cert, device cert, and private key
 * to the security tag defined in CONFIG_MQTT_HELPER_SEC_TAG.
 *
 * Must be called after nrf_modem_lib_init().
 * Modem will be set to offline mode (CFUN=4) internally.
 *
 * @return 0 on success, negative errno on error
 */
int cert_provision(void);

#endif /* CERT_PROVISION_H_ */
```
